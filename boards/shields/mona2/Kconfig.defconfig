## boards/shields/mona2/Kconfig.defconfig
```kconfig
# 右半分が Central（トラックボール・USB 接続側）。
# 通常の ZMK split keyboard では左が Central だが、moNa2 ではトラックボールが
# 右側にあるため右を Central として設定。
if SHIELD_MONA2_R

config ZMK_KEYBOARD_NAME
    default "mona2"

config ZMK_BLE
    default y

config ZMK_SPLIT_ROLE_CENTRAL
    default y

config INPUT
    default y

config ZMK_POINTING
    default y

config SPI
    default y

config PMW3610
    bool
    default y

# Driver-level inversion disabled — managed by input-processors in mona2_r.overlay
config PMW3610_INVERT_X
    bool
    default n

config PMW3610_INVERT_Y
    bool
    default n

endif

if SHIELD_MONA2_R || SHIELD_MONA2_L

config NFCT_PINS_AS_GPIOS
    default y

config ZMK_SPLIT
    default y

config RGBLED_WIDGET_BATTERY_LEVEL_HIGH
    int "Battery High Level"
    default 30

config RGBLED_WIDGET_BATTERY_LEVEL_CRITICAL
    int "Battery Critical Level"
    default 10

config RGBLED_WIDGET_SHOW_LAYER_COLORS
    bool "Show Layer Colors"
    default y

endif
```

## config/west.yml
```yaml
manifest:
  defaults:
    revision: main
  remotes:
    - name: cormoran
      url-base: https://github.com/cormoran
    - name: sayu-hub
      url-base: https://github.com/sayu-hub
    - name: badjeff
      url-base: https://github.com/badjeff
    - name: caksoylar
      url-base: https://github.com/caksoylar
    - name: zettaface
      url-base: https://github.com/zettaface
  projects:
    # ── Core ──────────────────────────────────────────────────────
    # ZMK: DYA Studio 用カスタム RPC サブシステム付き cormoran fork
    - name: zmk
      remote: cormoran
      revision: v0.3-branch+dya
      import: app/west.yml

    # ── Behavior ──────────────────────────────────────────────────
    # runtime sensor rotate モジュール本体
    - name: zmk-behavior-runtime-sensor-rotate
      remote: cormoran

    # ── Driver ────────────────────────────────────────────────────
    # トラックボール用ドライバー
    - name: zmk-pmw3610-driver
      remote: badjeff
      revision: zmk-0.3

    # ── DYA Studio モジュール（オプション: Studio UI 連携用）──────
    - name: zmk-module-ble-management
      remote: cormoran
    - name: zmk-module-battery-history
      remote: cormoran
    - name: zmk-module-settings-rpc
      remote: cormoran
    - name: zmk-module-runtime-input-processor
      remote: cormoran
  self:
    path: config
```
